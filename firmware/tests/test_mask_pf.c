/*
 * Host test for src/dsp/mask_pf.c -- waveform pass/fail masks.
 *
 * Real records from unit #1 (tests/fixtures/mask_pf_records.h, generated by
 * scripts/gen_mask_pf_fixture.py from the v0.4.0 regression capture), aligned
 * with the REAL anchor function the firmware uses (trig_edge_anchor), not a
 * host replica of it.
 *
 * Every acceptance has a negative control beside it that must come out the
 * other way, so a mask that passes everything (or fails everything) cannot
 * get through:
 *   held-out same signal  PASS   <->  same drive at the next timebase  FAIL
 *   +/-2% amplitude       PASS   <->  +/-30% amplitude                 FAIL
 *   6-count spike         PASS   <->  30-count spike  FAIL, at that column
 *   1-sample shift        PASS   <->  8-sample shift                   FAIL
 *   default tolerance     PASS   <->  zero tolerance on the same data  FAIL
 * plus each refusal path (untriggered, not ordered, no crossing, settings,
 * span, clipped teach) asserted by reason, and the statistics checked to
 * exclude refused records from the pass rate.
 */
#include <stdio.h>
#include <string.h>
#include <stdlib.h>
#include "mask_pf.h"
#include "trig_edge.h"
#include "fixtures/mask_pf_records.h"

static int g_run, g_fail;
#define CHECK(cond, ...) do { g_run++; if (!(cond)) { g_fail++; \
    printf("  FAIL %s:%d: ", __FILE__, __LINE__); printf(__VA_ARGS__); printf("\n"); } } while (0)

#define CROSSING 100   /* level 0 = reg 0x08 code 128, record units = 128 - 28 */
#define PRE      160   /* trigger mid-screen, the default horizontal position */

static mask_pf_t M;
static uint8_t   ENVBUF[MASK_PF_BUF_BYTES];   /* the firmware takes this from the heap */

static mask_pf_cond_t cond0(void)
{
    mask_pf_cond_t c;
    memset(&c, 0, sizeof(c));
    c.range[0] = 5; c.range[1] = 5;
    c.timebase = 0x10;
    c.trig_code = 128;
    return c;
}

static mask_pf_frame_t frame_of(const uint8_t *rec, int gen)
{
    mask_pf_frame_t f;
    memset(&f, 0, sizeof(f));
    f.rec[0] = rec;
    f.rec[1] = NULL;
    f.len = 1024;
    f.triggered = true;
    f.time_ordered = true;
    f.anchor = (int16_t)trig_edge_anchor(rec, CROSSING, 1);
    f.gen = (uint32_t)gen;
    f.cond = cond0();
    return f;
}

static void teach_hpos40(uint8_t tol_v, uint8_t tol_h)
{
    mask_pf_init(&M, ENVBUF);
    mask_pf_set_tol(&M, tol_v, tol_h);
    unsigned n = 0;
    for (unsigned i = 0; i < MASK_FIXTURE_N; i++)
        if (strcmp(MASK_FIXTURES[i].group, "hpos40") == 0) n++;
    mask_pf_teach_begin(&M, 0x01, PRE, (uint16_t)n);
    for (unsigned i = 0; i < MASK_FIXTURE_N; i++) {
        if (strcmp(MASK_FIXTURES[i].group, "hpos40") != 0) continue;
        mask_pf_frame_t f = frame_of(MASK_FIXTURES[i].rec, MASK_FIXTURES[i].gen);
        mask_pf_frame(&M, &f);
    }
}

static int is_heldout(const char *g)
{
    return !strcmp(g, "hpos160") || !strcmp(g, "hpos280") ||
           !strcmp(g, "sine10")  || !strcmp(g, "single");
}

/* Run every record of the predicate's groups through `xform` and count
 * verdicts. xform may be NULL (record as captured). */
typedef void (*xform_t)(uint8_t *dst, const uint8_t *src, int anchor, int arg);
static void run_groups(int (*pred)(const char *), xform_t xf, int arg,
                       int *pass, int *fail, int *skip)
{
    static uint8_t buf[1024];
    *pass = *fail = *skip = 0;
    for (unsigned i = 0; i < MASK_FIXTURE_N; i++) {
        if (!pred(MASK_FIXTURES[i].group)) continue;
        const uint8_t *r = MASK_FIXTURES[i].rec;
        int a = trig_edge_anchor(r, CROSSING, 1);
        if (xf) { xf(buf, r, a, arg); r = buf; }
        mask_pf_frame_t f = frame_of(r, MASK_FIXTURES[i].gen);
        f.anchor = (int16_t)a;             /* the alignment the capture had */
        mask_pf_result_t res = mask_pf_frame(&M, &f);
        if (res.verdict == MASK_PF_V_PASS) (*pass)++;
        else if (res.verdict == MASK_PF_V_FAIL) (*fail)++;
        else (*skip)++;
    }
}

/* Scale about the record's mean, in percent (arg = +/-pct). */
static void xf_scale(uint8_t *d, const uint8_t *s, int a, int pct)
{
    (void)a;
    long sum = 0;
    for (int i = 0; i < 1024; i++) sum += s[i];
    double mean = (double)sum / 1024.0, k = 1.0 + pct / 100.0;
    for (int i = 0; i < 1024; i++) {
        double v = mean + (s[i] - mean) * k;
        d[i] = (uint8_t)(v < 0 ? 0 : v > 255 ? 255 : v + 0.5);
    }
}

/* Delay the waveform by arg samples while the anchor stays put: what a
 * timing fault (or a misaligned anchor) looks like to the mask. */
static void xf_shift(uint8_t *d, const uint8_t *s, int a, int n)
{
    (void)a;
    for (int i = 0; i < 1024; i++) {
        int j = i - n;
        d[i] = s[j < 0 ? 0 : j > 1023 ? 1023 : j];
    }
}

static int g_spike_col;
static void xf_spike(uint8_t *d, const uint8_t *s, int a, int amp)
{
    memcpy(d, s, 1024);
    int i = a - PRE + g_spike_col;
    int v = d[i] + amp;
    d[i] = (uint8_t)(v > 255 ? 255 : v < 0 ? 0 : v);
}

static int is_sine11(const char *g) { return !strcmp(g, "sine11"); }
static int is_sq4hz(const char *g)  { return !strcmp(g, "sq4hz"); }
static int is_hpos40(const char *g) { return !strcmp(g, "hpos40"); }

int main(void)
{
    int p, f, s;

    printf("mask_pf: %u real records\n", (unsigned)MASK_FIXTURE_N);

    /* ── No envelope buffer: teaching is refused, not attempted. */
    mask_pf_init(&M, NULL);
    CHECK(!mask_pf_teach_begin(&M, 0x01, PRE, 4) && M.state == MASK_PF_EMPTY,
          "teach without a buffer must refuse");
    mask_pf_attach(&M, ENVBUF);
    CHECK(mask_pf_teach_begin(&M, 0x01, PRE, 4) && M.state == MASK_PF_TEACHING,
          "teach after attach");
    CHECK(!mask_pf_teach_begin(&M, 0x00, PRE, 4), "teach with no channel must refuse");

    /* ── Anchors: the real function finds the crossing on every sine record. */
    for (unsigned i = 0; i < MASK_FIXTURE_N; i++) {
        int a = trig_edge_anchor(MASK_FIXTURES[i].rec, CROSSING, 1);
        if (!strcmp(MASK_FIXTURES[i].group, "sq4hz"))
            CHECK(a < 0, "sq4hz gen %d: expected no crossing, got %d", MASK_FIXTURES[i].gen, a);
        else
            CHECK(a >= 464 && a <= 560, "%s gen %d: anchor %d", MASK_FIXTURES[i].group,
                  MASK_FIXTURES[i].gen, a);
    }

    /* ── Teach. */
    teach_hpos40(MASK_PF_TOL_V_DEFAULT, MASK_PF_TOL_H_DEFAULT);
    CHECK(M.state == MASK_PF_READY, "teach did not finish (got %u/%u)", M.teach_got, M.teach_target);
    CHECK(M.teach_got == 6, "teach_got %u", M.teach_got);
    uint8_t spread = mask_pf_teach_spread(&M);
    printf("  teach spread (6 known-good records): %u counts\n", spread);
    CHECK(spread <= 12, "teach spread %u: known-good records disagree", spread);
    CHECK(!M.rail_limited, "range-5 sine should not reach a rail");

    /* ── Bounds accessor agrees with the verdict: the default bound at a
     *    column holds every held-out sample there, and is tol_v outside the
     *    taught envelope (plus whatever dilation adds). */
    {
        uint8_t lo = 0, hi = 0;
        CHECK(mask_pf_bounds(&M, 0, 77, &lo, &hi) && hi > lo, "bounds at col 77: %u..%u", lo, hi);
        CHECK(!mask_pf_bounds(&M, 1, 77, &lo, &hi), "CH2 not in this mask");
        CHECK(!mask_pf_bounds(&M, 0, MASK_PF_SPAN, &lo, &hi), "column past the span");
    }

    /* ── Identity: the teach records pass their own mask. */
    run_groups(is_hpos40, NULL, 0, &p, &f, &s);
    CHECK(p == 6 && f == 0 && s == 0, "identity: %d pass %d fail %d skip", p, f, s);

    /* ── Held-out acceptance vs the different-timebase negative control. */
    mask_pf_reset_stats(&M);
    run_groups(is_heldout, NULL, 0, &p, &f, &s);
    printf("  held-out (20 records, minutes later): %d pass %d fail %d skip\n", p, f, s);
    CHECK(p == 20 && f == 0 && s == 0, "held-out must all pass");
    CHECK(M.tested == 20 && M.passed == 20, "stats tested %u passed %u", M.tested, M.passed);
    run_groups(is_sine11, NULL, 0, &p, &f, &s);
    printf("  same drive at timebase 0x11: %d pass %d fail -- worst %d counts\n",
           p, f, M.last_fail.worst);
    CHECK(f == 5 && p == 0, "different timebase must all fail");
    CHECK(M.last_fail.worst > 40, "a different timebase should miss by a lot, worst %d",
          M.last_fail.worst);
    CHECK(M.consec_fail == 5 && M.max_consec_fail == 5, "consec %u max %u",
          M.consec_fail, M.max_consec_fail);

    /* ── Amplitude sensitivity. */
    mask_pf_reset_stats(&M);
    run_groups(is_heldout, xf_scale, 2, &p, &f, &s);
    CHECK(p == 20, "+2%% amplitude: %d/20 pass", p);
    run_groups(is_heldout, xf_scale, -2, &p, &f, &s);
    CHECK(p == 20, "-2%% amplitude: %d/20 pass", p);
    run_groups(is_heldout, xf_scale, 30, &p, &f, &s);
    CHECK(f == 20, "+30%% amplitude: %d/20 fail", f);
    run_groups(is_heldout, xf_scale, -30, &p, &f, &s);
    CHECK(f == 20, "-30%% amplitude: %d/20 fail", f);
    int thr = 0;
    for (int pct = 1; pct <= 50 && !thr; pct++) {
        run_groups(is_heldout, xf_scale, pct, &p, &f, &s);
        if (f == 20) thr = pct;
    }
    int nthr = 0;
    for (int pct = 1; pct <= 50 && !nthr; pct++) {
        run_groups(is_heldout, xf_scale, -pct, &p, &f, &s);
        if (f == 20) nthr = pct;
    }
    printf("  smallest amplitude change failing all 20 at tol %u/%u: +%d%% / -%d%%\n",
           MASK_PF_TOL_V_DEFAULT, MASK_PF_TOL_H_DEFAULT, thr, nthr);
    CHECK(thr > 2 && thr <= 30, "+amplitude threshold %d%%", thr);
    CHECK(nthr > 2 && nthr <= 30, "-amplitude threshold %d%%", nthr);

    /* ── Glitch: a single-sample spike, located. */
    g_spike_col = 77;
    run_groups(is_heldout, xf_spike, 6, &p, &f, &s);
    CHECK(p == 20, "6-count spike (inside tolerance): %d/20 pass", p);
    run_groups(is_heldout, xf_spike, 30, &p, &f, &s);
    CHECK(f == 20, "30-count spike: %d/20 fail", f);
    CHECK(M.last_fail.first_col == 77 && M.last_fail.first_ch == 0,
          "spike located at col %d ch %d", M.last_fail.first_col, M.last_fail.first_ch);
    CHECK(M.last_fail.violations == 1, "spike: %u violations", M.last_fail.violations);
    CHECK(mask_pf_fail_col(&M, 0, 77) && !mask_pf_fail_col(&M, 0, 76) &&
          !mask_pf_fail_col(&M, 0, 78), "fail bitmap marks exactly column 77");
    g_spike_col = 0;                       /* the span edges are tested too */
    run_groups(is_heldout, xf_spike, -30, &p, &f, &s);
    CHECK(f == 20 && M.last_fail.first_col == 0, "spike at col 0: %d fail, col %d", f,
          M.last_fail.first_col);
    g_spike_col = MASK_PF_SPAN - 1;
    run_groups(is_heldout, xf_spike, 30, &p, &f, &s);
    CHECK(f == 20 && M.last_fail.first_col == MASK_PF_SPAN - 1, "spike at last col");
    /* Detection threshold for a one-sample glitch at a mid-slope column: it
     * is tol_v + slope x tol_h, not tol_v. Printed, not asserted -- it is a
     * property of the signal, and the design note quotes it. */
    g_spike_col = 77;
    int gthr = 0;
    for (int amp = 1; amp <= 60 && !gthr; amp++) {
        run_groups(is_heldout, xf_spike, amp, &p, &f, &s);
        if (f == 20) gthr = amp;
    }
    printf("  smallest +spike at column 77 failing all 20: %d counts\n", gthr);

    /* ── Timing. */
    run_groups(is_heldout, xf_shift, 1, &p, &f, &s);
    CHECK(p == 20, "1-sample shift: %d/20 pass", p);
    run_groups(is_heldout, xf_shift, -1, &p, &f, &s);
    CHECK(p == 20, "-1-sample shift: %d/20 pass", p);
    run_groups(is_heldout, xf_shift, 8, &p, &f, &s);
    CHECK(f == 20, "8-sample shift: %d/20 fail", f);
    /* Edge margin: with tol_h = 8 a 4-sample shift passes, INCLUDING at the
     * span edges, which see real envelope beyond the span (the first run,
     * without the margin, false-failed 19/20 here). */
    mask_pf_set_tol(&M, MASK_PF_TOL_V_DEFAULT, 8);
    run_groups(is_heldout, xf_shift, 4, &p, &f, &s);
    CHECK(p == 20, "4-sample shift at tol_h 8: %d/20 pass", p);
    run_groups(is_heldout, xf_shift, -4, &p, &f, &s);
    CHECK(p == 20, "-4-sample shift at tol_h 8: %d/20 pass", p);
    mask_pf_set_tol(&M, MASK_PF_TOL_V_DEFAULT, MASK_PF_TOL_H_DEFAULT);

    /* ── Tolerance is load-bearing: zero tolerance fails the held-out set. */
    mask_pf_set_tol(&M, 0, 0);
    CHECK(M.tested == 0, "set_tol must reset stats");
    run_groups(is_heldout, NULL, 0, &p, &f, &s);
    printf("  zero tolerance on the held-out set: %d pass %d fail\n", p, f);
    CHECK(f > 0, "zero tolerance should fail some held-out records");
    mask_pf_set_tol(&M, 255, MASK_PF_HMAX);  /* and a huge one passes even 0x11 */
    run_groups(is_sine11, NULL, 0, &p, &f, &s);
    CHECK(p == 5, "huge tolerance passes 0x11 (the mask, not the data, decides)");
    CHECK(M.rail_limited, "a 255-count tolerance must report rail limiting");
    mask_pf_set_tol(&M, MASK_PF_TOL_V_DEFAULT, MASK_PF_TOL_H_DEFAULT);
    CHECK(!M.rail_limited, "default tolerance clears rail_limited again");

    /* ── Refusals, by reason, and excluded from the pass rate. */
    mask_pf_reset_stats(&M);
    run_groups(is_sq4hz, NULL, 0, &p, &f, &s);
    CHECK(s == 2 && M.skipped[MASK_PF_R_NO_ANCHOR] == 2, "sq4hz: no-anchor skips %u",
          M.skipped[MASK_PF_R_NO_ANCHOR]);
    const uint8_t *good = NULL;
    int good_gen = 0;
    for (unsigned i = 0; i < MASK_FIXTURE_N; i++)
        if (!strcmp(MASK_FIXTURES[i].group, "hpos160")) { good = MASK_FIXTURES[i].rec; good_gen = MASK_FIXTURES[i].gen; break; }
    mask_pf_frame_t fr = frame_of(good, good_gen);
    fr.triggered = false;
    CHECK(mask_pf_frame(&M, &fr).reason == MASK_PF_R_UNTRIGGERED, "untriggered");
    fr = frame_of(good, good_gen);
    fr.stale = true;               /* a good record, but held across a stop */
    CHECK(mask_pf_frame(&M, &fr).reason == MASK_PF_R_STALE, "stale record skipped, not scored");
    fr = frame_of(good, good_gen);
    fr.time_ordered = false;
    CHECK(mask_pf_frame(&M, &fr).reason == MASK_PF_R_NOT_ORDERED, "not ordered");
    fr = frame_of(good, good_gen);
    fr.cond.timebase = 0x11;
    mask_pf_result_t rr = mask_pf_frame(&M, &fr);
    CHECK(rr.reason == MASK_PF_R_SETTINGS && rr.cond_diff == MASK_PF_C_TIMEBASE,
          "timebase change: reason %d diff 0x%02x", rr.reason, rr.cond_diff);
    fr = frame_of(good, good_gen);
    fr.cond.trig_code = 140;
    CHECK(mask_pf_frame(&M, &fr).cond_diff == MASK_PF_C_TRIG_LEVEL, "level change");
    fr = frame_of(good, good_gen);
    fr.cond.range[1] = 7;                  /* CH2 is not in this mask */
    CHECK(mask_pf_frame(&M, &fr).verdict == MASK_PF_V_PASS, "CH2 range change ignored for a CH1 mask");
    fr = frame_of(good, good_gen);
    fr.anchor = 100;                       /* 100 - 160 < 0 */
    CHECK(mask_pf_frame(&M, &fr).reason == MASK_PF_R_SPAN, "span off record");
    CHECK(M.tested == 1 && M.passed == 1, "refusals must not count as tested: tested %u", M.tested);
    CHECK(M.skipped[MASK_PF_R_UNTRIGGERED] == 1 && M.skipped[MASK_PF_R_NOT_ORDERED] == 1 &&
          M.skipped[MASK_PF_R_SETTINGS] == 2 && M.skipped[MASK_PF_R_SPAN] == 1 &&
          M.skipped[MASK_PF_R_STALE] == 1,
          "skip counters");

    /* ── Teach refusals: clipped record, settings drift mid-teach, no mask. */
    mask_pf_teach_begin(&M, 0x01, PRE, 2);
    static uint8_t clip[1024];
    memcpy(clip, good, 1024);
    int ca = trig_edge_anchor(clip, CROSSING, 1);
    clip[ca - PRE + 10] = 255;
    fr = frame_of(clip, 1);
    rr = mask_pf_frame(&M, &fr);
    CHECK(rr.reason == MASK_PF_R_CLIPPED && M.teach_got == 0, "clipped teach rejected");
    fr = frame_of(good, good_gen);
    mask_pf_frame(&M, &fr);
    fr.cond.range[0] = 6;
    rr = mask_pf_frame(&M, &fr);
    CHECK(rr.reason == MASK_PF_R_SETTINGS && M.teach_got == 1 && M.state == MASK_PF_TEACHING,
          "range change mid-teach rejected");
    mask_pf_clear(&M);
    fr = frame_of(good, good_gen);
    CHECK(mask_pf_frame(&M, &fr).reason == MASK_PF_R_NO_MASK, "no mask");
    CHECK(M.tol_v == MASK_PF_TOL_V_DEFAULT, "clear keeps tolerances");

    /* ── Two channels: a violation on CH2 alone fails, and is attributed. */
    mask_pf_teach_begin(&M, 0x03, PRE, 1);
    fr = frame_of(good, good_gen);
    fr.rec[1] = good;
    mask_pf_frame(&M, &fr);
    CHECK(M.state == MASK_PF_READY, "2-ch teach");
    static uint8_t ch2[1024];
    memcpy(ch2, good, 1024);
    ch2[ca - PRE + 200] = (uint8_t)(ch2[ca - PRE + 200] + 30);
    fr = frame_of(good, good_gen);
    fr.rec[1] = ch2;
    rr = mask_pf_frame(&M, &fr);
    CHECK(rr.verdict == MASK_PF_V_FAIL && rr.first_ch == 1 && rr.first_col == 200,
          "CH2 violation: verdict %d ch %d col %d", rr.verdict, rr.first_ch, rr.first_col);
    fr.rec[1] = NULL;
    CHECK(mask_pf_frame(&M, &fr).reason == MASK_PF_R_SPAN, "masked channel missing");

    printf("%d/%d checks passed\n", g_run - g_fail, g_run);
    return g_fail ? 1 : 0;
}
